## boards/shields/tbk/Kconfig.defconfig
```kconfig
if SHIELD_TBK_LEFT || SHIELD_TBK_RIGHT

config ZMK_KEYBOARD_NAME
    default "TBK Mini"

config ZMK_SPLIT
    default y

if SHIELD_TBK_LEFT

config ZMK_SPLIT_ROLE_CENTRAL
    default y

endif # SHIELD_TBK_LEFT

endif # SHIELD_TBK_LEFT || SHIELD_TBK_RIGHT
```
